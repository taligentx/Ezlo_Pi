## firmware/ezlopi/sdkconfig.defaults.esp32s3
```kconfig
CONFIG_ESP32S3_DEFAULT_CPU_FREQ_240=y
CONFIG_ESPTOOLPY_FLASHSIZE_8MB=y
CONFIG_BT_BLE_42_FEATURES_SUPPORTED=y
```

## sdkconfig.defaults
```kconfig
CONFIG_PARTITION_TABLE_CUSTOM=y
CONFIG_PARTITION_TABLE_FILENAME="partitions.csv"
CONFIG_BT_ENABLED=y
CONFIG_LWIP_TCPIP_TASK_AFFINITY_CPU0=y
CONFIG_WIFI_PROV_BLE_BONDING=y
CONFIG_WIFI_PROV_BLE_FORCE_ENCRYPTION=y
```

## sdkconfig.defaults.esp32
```kconfig
CONFIG_ESP32_DEFAULT_CPU_FREQ_240=y
CONFIG_ESPTOOLPY_FLASHSIZE_4MB=y
CONFIG_ETH_SPI_ETHERNET_W5500=y
CONFIG_FREERTOS_PLACE_FUNCTIONS_INTO_FLASH=y
```

## sdkconfig.defaults.esp32c3
```kconfig
CONFIG_ESP32S3_DEFAULT_CPU_FREQ_240=y
CONFIG_ESPTOOLPY_FLASHSIZE_4MB=y
CONFIG_ETH_SPI_ETHERNET_W5500=y
CONFIG_BT_BLE_42_FEATURES_SUPPORTED=y
```

## sdkconfig.defaults.esp32s3
```kconfig
CONFIG_ESP32S3_DEFAULT_CPU_FREQ_240=y
CONFIG_ESPTOOLPY_FLASHSIZE_8MB=y
CONFIG_ETH_SPI_ETHERNET_W5500=y
CONFIG_BT_BLE_42_FEATURES_SUPPORTED=y
CONFIG_SYSTEM_EVENT_TASK_STACK_SIZE=3072
```
